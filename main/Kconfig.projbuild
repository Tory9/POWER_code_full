## main/Kconfig.projbuild
```kconfig
menu "Example Configuration"
    config EXAMPLE_HTTP_ENDPOINT
        string "Example HTTP Endpoint"
        default "httpbin.org"
        help


    config EXAMPLE_STORE_HISTORY
        bool "Store command history in flash"
        default y
        help
            Linenoise line editing library provides functions to save and load
            command history. If this option is enabled, initalizes a FAT filesystem
            and uses it to store command history.
        
    config CONFIG_EXAMPLE_I2C_MASTER_SCL
        int "SCL GPIO Num"
        default 19 if IDF_TARGET_ESP32
        default 4
        help
            GPIO number for I2C Master clock line.
        
    config CONFIG_EXAMPLE_I2C_MASTER_SDA
        int "SDA GPIO Num"
        default 18 if IDF_TARGET_ESP32
        default 5
        help
            GPIO number for I2C Master data line.


    config MY_SPI_HOST
    int "SPI Host"
    default 1
    help
      Set SPI Host. Use 1 for SPI2_HOST or 2 for SPI3_HOST.

config MY_MISO_GPIO
    int "MISO GPIO"
    default 13
    range 0 39
    help
      GPIO number for MISO.

config MY_MOSI_GPIO
    int "MOSI GPIO"
    default 11
    range 0 39
    help
      GPIO number for MOSI.

config MY_SCLK_GPIO
    int "SCLK GPIO"
    default 12
    range 0 39
    help
      GPIO number for SCLK.

config MY_CE_GPIO
    int "CE GPIO"
    default 9
    range 0 39
    help
      GPIO number for CE.

config MY_CSN_GPIO
    int "CSN GPIO"
    default 10
    range 0 39
    help
      GPIO number for CSN.

config MY_SPI_HOST
    int "SPI Host"
    default 1
    help
      Set SPI Host. Use 1 for SPI2_HOST or 2 for SPI3_HOST.

config MY_MISO_GPIO
    int "MISO GPIO"
    default 13
    range 0 39
    help
      GPIO number for MISO.

config MY_MOSI_GPIO
    int "MOSI GPIO"
    default 11
    range 0 39
    help
      GPIO number for MOSI.

config MY_SCLK_GPIO
    int "SCLK GPIO"
    default 12
    range 0 39
    help
      GPIO number for SCLK.

config MY_CE_GPIO
    int "CE GPIO"
    default 9
    range 0 39
    help
      GPIO number for CE.

config MY_CSN_GPIO
    int "CSN GPIO"
    default 10
    range 0 39
    help
      GPIO number for CSN.

    
endmenu
```
